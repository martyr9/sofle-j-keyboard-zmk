## boards/arm/eyelash_sofle/Kconfig.board
```kconfig
#
# Copyright (c) 2024 The ZMK Contributors
# SPDX-License-Identifier: MIT
#

config BOARD_EYELASH_SOFLE_LEFT
    bool "eyelash_sofle_left"
    depends on SOC_NRF52840_QIAA

config BOARD_EYELASH_SOFLE_RIGHT
    bool "eyelash_sofle_right"
    depends on SOC_NRF52840_QIAA
```

## boards/arm/eyelash_sofle/Kconfig.defconfig
```kconfig
# SPDX-License-Identifier: MIT

if BOARD_EYELASH_SOFLE_LEFT

config BOARD
    default "eyelash_sofle_left"

config ZMK_KEYBOARD_NAME
    default "Eyelash Sofle"

if USB_DEVICE_STACK

config USB_NRFX
    default y

endif # USB_DEVICE_STACK

config BT_CTLR
   default BT

config ZMK_BLE
   default y

config ZMK_USB
   default y

endif # BOARD_EYELASH_SOFLE_LEFT

if BOARD_EYELASH_SOFLE_RIGHT

config BOARD
    default "eyelash_sofle_right"

config ZMK_KEYBOARD_NAME
    default "Eyelash Sofle"

if USB_DEVICE_STACK

config USB_NRFX
    default y

endif # USB_DEVICE_STACK

config BT_CTLR
   default BT

config ZMK_BLE
   default y

config ZMK_USB
   default y

endif # BOARD_EYELASH_SOFLE_RIGHT
```
